/*
 * Panther device tree overlay
 */


/dts-v1/;
/plugin/;


/{
    compatible = "ti,beaglebone", "ti,beaglebone-black";
    part_number = "test";


    exclusive-use =
        "P8.13", // 	gpio0.23, 	PIN 9, 		GPIO  23
        "P8.11", // 	gpio1.13, 	PIN 13, 	GPIO  45
        "P8.12", // 	gpio1.12, 	PIN 12, 	GPIO  44
        "P8.15", // 	gpio1.15, 	PIN 15, 	GPIO  47
        "P8.16", // 	gpio1.14, 	PIN 14, 	GPIO  46 
        "P9.25", // 	gpio3.21, 	PIN 107,	GPIO  117 
        "P9.13", // 	gpio0.31, 	PIN 29 ,	GPIO  31
        "P9.21", // 	gpio0.3,  	PIN 85, 	GPIO  3
        "P9.22", // 	gpio0.2,  	PIN 84, 	GPIO  2
	"P9.17", // 	gpio0.5,  	PIN 86, 	GPIO  4
        "P8.7",  // 	gpio2.2,  	PIN 36, 	GPIO  66
        "P8.19", // 	gpio0.22, 	PIN 8, 		GPIO  22
        "P9.41", // 	gpio0.20, 	PIN 109, 	GPIO  20
	"P9.26", // 	gpio0.14, 	PIN 96, 	GPIO  14
        "P9.18", // 	gpio0.4,  	PIN 87, 	GPIO  5
        "P9.42", // 	gpio0.7,  	PIN 89, 	GPIO  7
        "P9.11", // 	gpio0.30, 	PIN 28, 	GPIO  30
        "P9.23", // 	gpio1.17,  	PIN 17, 	GPIO  49
       	"P9.14", // 	gpio1.18, 	PIN 18, 	GPIO  40
        "P9.15", // 	gpio1.16, 	PIN 16, 	GPIO  48
        "P8.10", // 	gpio2.4,  	PIN 38, 	GPIO  68
        "P8.14", // 	gpio0.26, 	PIN 10, 	GPIO  26
        "P8.17", // 	gpio0.27, 	PIN 11, 	GPIO  27
        "P8.18", // 	gpio2.1,  	PIN 35, 	GPIO  65
        "P9.12", // 	gpio1.28, 	PIN 30, 	GPIO  60
        "P9.16", // 	gpio1.19, 	PIN 19, 	GPIO  51
        "P9.24", // 	gpio0.15, 	PIN 97, 	GPIO  15
        "P9.27", //	gpio3.19, 	PIN 105, 	GPIO  125   
        "P8.26", // 	gpio1.29, 	PIN 31, 	GPIO  61  
        "P9.30", // 	gpio3.16,  	PIN 102, 	GPIO  122   
        "P8.8",  // 	gpio2.3,  	PIN 37, 	GPIO  67
        "P8.9",  // 	gpio2.5, 	PIN 39, 	GPIO  69
 	
	"gpio0.23",
	"gpio1.13",
	"gpio1.12",
	"gpio1.15",
	"gpio1.14",
	"gpio3.21",
	"gpio0.31",
	"gpio0.3",
	"gpio0.2",
	"gpio0.5",
	"gpio2.2",
	"gpio0.22",
	"gpio0.20",
	"gpio0.14",
	"gpio0.4",
	"gpio0.7",
	"gpio0.30",
	"gpio1.17",
	"gpio1.18",
	"gpio1.16",
	"gpio2.4",
	"gpio0.26",
	"gpio0.27",
	"gpio2.1",
	"gpio1.28",
	"gpio1.19",
	"gpio0.15",
	"gpio3.19",
	"gpio1.29",
	"gpio3.16",
	"gpio2.3",
	"gpio2.5",

	 "pru0";


    fragment@0 {
        target = <&am33xx_pinmux>;
        __overlay__ {
            foo_pins: foo_pins {
                pinctrl-single,pins = <
			
			 0x024 0x3f
			 0x034 0x3f
			 0x030 0x3f
			 0x03c 0x3f
			 0x038 0x3f
			 0x1ac 0x3f
			 0x074 0x3f
			 0x154 0x3f
			 0x150 0x3f
			 0x158 0x37
			 0x090 0x3f
			 0x020 0x3f
			 0x1b4 0x3f
			 0x180 0x3f
			 0x15c 0x3f
			 0x164 0x3f
			 0x070 0x3f
			 0x044 0x3f
			 0x048 0x3f
			 0x040 0x3f
			 0x098 0x3f
			 0x028 0x3f
			 0x02c 0x3f
			 0x08c 0x3f
			 0x078 0x3f
			 0x04c 0x3f
			 0x184 0x3f
			 0x1a4 0x3f
			 0x07c 0x3f
			 0x198 0x3f
			 0x094 0x3f
			 0x09c 0x3f
			 

		 >;
            };
        };
    };


    fragment@1 {
        target = <&pruss>;
        __overlay__ {
                status = "okay";
                pinctrl-names = "default";
                pinctrl-0 = <&foo_pins>;
        };
    };
};
